## yocto/conf/bblayers.conf.sample
```bitbake
# HomeAgent Yocto Layer Configuration
# Copy to build/conf/bblayers.conf after oe-init-build-env

# POKY_BBLAYERS_CONF_VERSION is increased each time build/conf/bblayers.conf
# changes incompatibly
POKY_BBLAYERS_CONF_VERSION = "2"

BBPATH = "${TOPDIR}"
BBFILES ?= ""

# Adjust SOURCES to your actual path
SOURCES = "${TOPDIR}/../sources"

BBLAYERS ?= " \
  ${SOURCES}/poky/meta \
  ${SOURCES}/poky/meta-poky \
  ${SOURCES}/poky/meta-yocto-bsp \
  \
  ${SOURCES}/meta-openembedded/meta-oe \
  ${SOURCES}/meta-openembedded/meta-python \
  ${SOURCES}/meta-openembedded/meta-networking \
  ${SOURCES}/meta-openembedded/meta-multimedia \
  \
  ${SOURCES}/meta-raspberrypi \
  \
  ${TOPDIR}/../meta-homeagent \
  "
# meta-flutter는 kirkstone 기반이라 scarthgap 호환성 확인 후 추가
# ${SOURCES}/meta-flutter
```

## yocto/conf/local.conf.sample
```bitbake
# HomeAgent Yocto Build Configuration
# Copy to build/conf/local.conf after oe-init-build-env

# Machine: Raspberry Pi 5
MACHINE = "raspberrypi5"

# Distro features (usrmerge: scarthgap systemd 필수)
DISTRO_FEATURES:append = " systemd wifi bluetooth pam usrmerge"
DISTRO_FEATURES_BACKFILL_CONSIDERED:append = " sysvinit"
VIRTUAL-RUNTIME_init_manager = "systemd"
VIRTUAL-RUNTIME_initscripts = "systemd-compat-units"

# OpenGL ES / Wayland
DISTRO_FEATURES:append = " opengl wayland"

# Thread/Matter support
DISTRO_FEATURES:append = " ipv6"

# Parallel build settings (adjust to your system)
BB_NUMBER_THREADS ?= "8"
PARALLEL_MAKE ?= "-j 8"

# Download/cache directories (persistent)
DL_DIR ?= "${TOPDIR}/../downloads"
SSTATE_DIR ?= "${TOPDIR}/../sstate-cache"

# SDK target (for cross-compilation)
SDKMACHINE = "x86_64"

# SSH: openssh 사용 (dropbear 대신)
EXTRA_IMAGE_FEATURES += "ssh-server-openssh"
IMAGE_FEATURES:remove = "ssh-server-dropbear"
BAD_RECOMMENDATIONS += "packagegroup-core-ssh-dropbear dropbear"

# Root password: 기본 "homeagent" (첫 로그인 후 변경 권장)
INHERIT += "extrausers"
EXTRA_USERS_PARAMS = "usermod -P homeagent root;"

# Extra packages for development
IMAGE_INSTALL:append = " \
    nano \
    vim \
    htop \
    ssh-keys \
    shell-config \
    "

# OpenThread Border Router (Phase 2에서 활성화)
# IMAGE_INSTALL:append = " ot-br-posix"

# Mesa for RPi5 GPU
IMAGE_INSTALL:append = " \
    libegl-mesa \
    libgles2-mesa \
    "

# Kernel modules
IMAGE_INSTALL:append = " \
    kernel-modules \
    "

# Firmware
IMAGE_INSTALL:append = " \
    linux-firmware-rpidistro-bcm43455 \
    bluez-firmware-rpidistro-bcm4345c0-hcd \
    "

# SD card image format
IMAGE_FSTYPES = "wic.bz2 wic.bmap"

# License compliance
LICENSE_FLAGS_ACCEPTED = "synaptics-killswitch"

# Extra disk space (MB)
IMAGE_ROOTFS_EXTRA_SPACE = "1048576"
```
