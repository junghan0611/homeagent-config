## yocto/build-opi5/conf/local.conf
```bitbake
# HomeAgent Yocto Build — Orange Pi 5 (RK3588S)
# Step 1: SSH 부팅 검증 (radxa u-boot + mainline 커널)
# Step 2: 커널을 vendor 6.1로 교체 → NPU 검증

MACHINE = "orangepi-5"

# Distro features
DISTRO_FEATURES:append = " systemd wifi bluetooth pam usrmerge"
DISTRO_FEATURES_BACKFILL_CONSIDERED:append = " sysvinit"
VIRTUAL-RUNTIME_init_manager = "systemd"
VIRTUAL-RUNTIME_initscripts = "systemd-compat-units"

# Thread/Matter support
DISTRO_FEATURES:append = " ipv6"

# Parallel build (thinkpad: 8 core i7)
BB_NUMBER_THREADS ?= "6"
PARALLEL_MAKE ?= "-j 8"
PARALLEL_MAKE:pn-clang-native = "-j 4"

# Download/cache (RPi5 빌드와 공유)
DL_DIR ?= "${TOPDIR}/../downloads"
SSTATE_DIR ?= "${TOPDIR}/../sstate-cache"

SDKMACHINE = "x86_64"

# RPi5 전용 bbappend 무시
BB_DANGLINGAPPENDS_WARNONLY = "1"

# SSH: openssh
EXTRA_IMAGE_FEATURES += "ssh-server-openssh"
IMAGE_FEATURES:remove = "ssh-server-dropbear"
BAD_RECOMMENDATIONS += "packagegroup-core-ssh-dropbear dropbear"

# Root password: "homeagent"
INHERIT += "extrausers"
EXTRA_USERS_PARAMS = "usermod -p '\$6\$homeagent\$TzrgPYw/S2Sx4cVt9FbdKL1niRzCtEAvzz6SKq42DTz6DWZiEefWDbiP1l1F942/4a/tu1gSiqywpEUIo.O/p.' root;"

# === 기본 도구 ===
IMAGE_INSTALL:append = " \
    nano \
    vim \
    htop \
    iproute2 \
    kernel-modules \
    ssh-keys \
    shell-config \
    "

# 런타임 패키지 관리 (opkg)
EXTRA_IMAGE_FEATURES += "package-management"

# 커널: linux-yocto-dev (mainline, OPi5 DTS 포함)
PREFERRED_PROVIDER_virtual/kernel = "linux-yocto-dev"
COMPATIBLE_MACHINE:pn-linux-yocto-dev = "orangepi-5"
KERNEL_FEATURES:remove:pn-linux-yocto-dev = "bsp/rockchip/remove-non-rockchip-arch-arm64.scc"

# 이미지 포맷
IMAGE_FSTYPES = "wic.bz2 wic.bmap"

# Extra disk space (512MB)
IMAGE_ROOTFS_EXTRA_SPACE = "524288"
```

## yocto/meta-homeagent/conf/layer.conf
```bitbake
# HomeAgent custom layer
BBPATH .= ":${LAYERDIR}"
BBFILES += "${LAYERDIR}/recipes-*/*/*.bb \
            ${LAYERDIR}/recipes-*/*/*.bbappend"
BBFILE_COLLECTIONS += "meta-homeagent"
BBFILE_PATTERN_meta-homeagent = "^${LAYERDIR}/"
LAYERSERIES_COMPAT_meta-homeagent = "scarthgap"
```

## yocto/meta-homeagent/conf/machine/orangepi-5.conf
```bitbake
#@TYPE: Machine
#@NAME: Orange Pi 5
#@DESCRIPTION: Orange Pi 5 with Rockchip RK3588S
#http://www.orangepi.org/html/hardWare/computerAndMicrocontrollers/details/Orange-Pi-5.html

require conf/machine/include/rk3588s.inc

KERNEL_DEVICETREE = "rockchip/rk3588s-orangepi-5.dtb"
MACHINE_EXTRA_RRECOMMENDS += "kernel-modules"

UBOOT_MACHINE = "orangepi-5-rk3588s_defconfig"
```
